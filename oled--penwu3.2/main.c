/**/




#include <STC89C5xRC.H>
#include <intrins.h>
#include "dht22.h"
#include "oled.h"
#include <stdio.h>

#include "picture.h"	


#define uint unsigned int 
#define uchar unsigned char	
/*************************************************************************************************
*																			PIN脚定义
*************************************************************************************************/
//水位检测
sbit Water_level = P1^0;									
sbit buzzzer = P2^4;
sbit led2 =P1^7;				

//喷雾检测
sbit led = P1^6;
sbit pwm1 =P1^1;			//1档
sbit pwm2 =P1^5;			//2档


//独立按键																	
sbit Key_L = P1^2;												
sbit Key_H = P1^3;
sbit key_ctrl =P1^4;			//挡位控制
/*************************************************************************************************
*																			全局变量
*************************************************************************************************/
struct countkey												//按键扫描结构体
{
	volatile unsigned int debounce_count;				//中断计数器0
	volatile unsigned int debounce_count2;			//中断计数器2
	volatile unsigned int debounce_count3;
	int warring;										//预警湿度
} key={0,0,0,90};  									//中断计数器0,中断计数器2,检测		

struct Gear													//喷雾工作结构体
{
	unsigned char flag;				//		判断工作
	volatile unsigned char count;			//挡位
} atomizing={0,2};

struct oled_show													//oled显示中间变量												
{
	unsigned char humidity2[5];								
	unsigned char temperature2[5];
	int warring2[3];
	int count2[2];
}Invert;
/*************************************************************************************************
*																			oled字模库
*************************************************************************************************/
unsigned char code F16x16[] =//中文字模 	 
{ 
	
0x20,0x20,0x20,0x20,0x20,0x20,0x21,0x22,0x2C,0x20,0x20,0x20,0x20,0x20,0x20,0x00,
0x00,0x40,0x20,0x10,0x0C,0x03,0x00,0x00,0x00,0x01,0x02,0x04,0x18,0x60,0x00,0x00,/*"六",0*/

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0x01,0x00,0x00,0xFF,0x40,0x40,0x41,0x5E,0x40,0x40,0x70,0x4E,0x41,0x40,0x40,0x00,/*"位",11*/
};
const unsigned char code F8X16[]=	//字符串  
{
  0x00,0x00,0x00,0x00,0x00,0x00,0x00,0x00,0x00,0x00,0x00,0x00,0x00,0x00,0x00,0x00,//  0
  0x00,0x00,0x00,0xF8,0x00,0x00,0x00,0x00,0x00,0x00,0x00,0x33,0x30,0x00,0x00,0x00,//! 1
  0x00,0x10,0x0C,0x06,0x10,0x0C,0x06,0x00,0x00,0x00,0x00,0x00,0x00,0x00,0x00,0x00,//" 2
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  0x00,0x06,0x01,0x01,0x02,0x02,0x04,0x04,0x00,0x00,0x00,0x00,0x00,0x00,0x00,0x00,//~ 94
};






/*************************************************************************************************
*																			函数声明
*************************************************************************************************/
void Timer0Init(void);		//10微秒挡位检测
void timer0_isr();

void Timer1Init(void);		//1毫秒@12.000MHz		//按键
void timer1_isr();

void float_to_str(float num,int t_size, char *str, unsigned char a);		//浮点数转字符串
void int_to_str(int num,int t_size, char *str, unsigned char a);//整型转字符串

void water_buzzer();		//水位检测
void dht22_oled();			//显示dht22
void atomizing_choose();				//喷雾挡位选择


void pwm(unsigned char cnt);			//选择挡位
void Key_Loop(void);							//判断挡位
unsigned char Key_GetState();			//按键获取	

void OLED_ShowNumber(unsigned char x, y,int num,unsigned char str[],unsigned char len);
void OLED_Showfloat(unsigned char x, y,unsigned char str[],float temp);
/*************************************************************************************************
*																				主程序
*************************************************************************************************/
void main()
{
	Initial_M096128x64_ssd1306();			//oled初始化
	OLED_Clear();											//清屏
	/********************************************开机动画************************************************/
	//16*16大小的字体
		Xianshi_16X16(4,4,0);//	显示六
		Xianshi_16X16(21,4,1);//显示职
		Xianshi_16X16(38,4,2);//显示启
		Xianshi_16X16(54,4,3);//显示智
		Xianshi_16X16(71,4,4);//显示队
		Xianshi_8X16(46,6,"2023.10.22");
	/********************************************dht22初始化********************************************************/	
	
	DHT22_init();
	//Read_Lcd();//读取温湿度
	Delay_50ms(20);
	
	OLED_Clear();						//清屏
	/******************************************定时器**********************************************************/
	Timer1Init();
		
	while(1)
	{	
		water_buzzer();		//水位检测
		dht22_oled();			//dht22显示
		atomizing_choose();		//喷雾挡位开启
		delay(2000);
	}
}

void Timer1Init(void)		//1毫秒@12.000MHz
{
	TMOD &= 0x0F;		//设置定时器模式
	TL1 = 0x20;		//设置定时初值
	TH1 = 0xD1;		//设置定时初值
	TF1 = 0;		//清除TF1标志

	ET1=1;
	EA=1;
	
	TR1 = 1;		//定时器1开始计时
}


void timer1_isr() interrupt 3 
{
	Key_Loop();		//挡位按键扫描
	
	if(Key_L==0)										//warring调节按键
	{
		if(key.debounce_count < 16)
		{
			key.debounce_count++;				//计数器
		}else
		{
			key.warring--;
			key.debounce_count-=16;
		}
	}
	if(Key_H==0)
	{		
		if(key.debounce_count2 < 16)
		{
			key.debounce_count2++;
		}else
		{
			key.warring++;
			key.debounce_count2-=16;
		}		
	}
}
void water_buzzer()				//检测水位
{
	unsigned char i;
	if(Water_level==1)												//水位检测,无水
	{
		atomizing.flag=0;
		pwm(3);					//停止挡位
		//声光报警
		led2=0;
		for(i=0;i<2;i++)		
		{												
			buzzzer=0;
		}
	}else
	{
		if(humidity<key.warring)
		{
			atomizing.flag=1;			//喷雾标志位
		}else
		{
			atomizing.flag=0;
			pwm(3);					//停止挡位
		}
	}
	//结束声光报警
	if(Water_level==0)
	{
		led2=1;
		buzzzer=1;
	}
}

void dht22_oled()					//温湿度检测
{
	Read_Lcd();//读取温湿度
	//显示湿度
	Xianshi_16X16(0,4,6);
	Xianshi_16X16(16,4,7);
	Xianshi_8X16(33,4,":");
	humidity=humidity+((long int)(humidity*10)%10)/10;				//显示小数点
	
	OLED_Showfloat(49,4,Invert.humidity2,humidity);							//显示变量

	
	//显示温度
	if(flag)
	{
		Xianshi_8X16(40,4,"-");
	}else
	{
		Xianshi_8X16(40,4," ");
	}
	Xianshi_16X16(0,6,5);//	显示温度
	Xianshi_16X16(16,6,7);//	显示
	Xianshi_8X16(33,6,":");		
	temperature=temperature+((long int)(temperature*10)%10)/10;				//显示小数点
	OLED_Showfloat(49,6,Invert.temperature2,temperature);							//显示变量

	//显示阈值
	if(key.warring<0)																									//判断温度正负
	{
		Xianshi_8X16(81,3,"-");
	}else
	{
		Xianshi_8X16(81,3," ");
	}
	Xianshi_16X16(60,0,8);//	显示预设温度
	Xianshi_16X16(77,0,9);//	显示
	Xianshi_16X16(94,0,6);//	显示
	Xianshi_16X16(111,0,7);//	显示
	OLED_ShowNumber(87,2,key.warring,Invert.warring2,3);
	
	
	
	Xianshi_16X16(0,0,10);//	显示挡位
	Xianshi_16X16(16,0,11);//	显示
	OLED_ShowNumber(4,2,atomizing.count,Invert.count2,2);
			
 }
void atomizing_choose()				//喷雾挡位选择
{	
	if(atomizing.flag==1)
	{
		pwm(atomizing.count);
	}
}

unsigned char Key_GetState()		//按键判断
{
	unsigned char KeyNumber=0;
	
	if(key_ctrl==0){KeyNumber=1;}

	return KeyNumber;
}

void Key_Loop(void)				//按键扫描
{
	static unsigned char NowState,LastState;
	LastState=NowState;				//按键状态更新
	NowState=Key_GetState();		//获取当前按键状态
	//如果上个时间点按键按下，这个时间点未按下，则是松手瞬间，以此避免消抖和松手检测
	if(LastState==1 && NowState==0)
	{
		atomizing.count++;
	}
	if(atomizing.count>=4)
	{
		atomizing.count=1;
	}
}

void pwm(unsigned char cnt)		//挡位选择
{
	switch(cnt)
	{
		case 1:	led=0;
						pwm1=0;				//1档
						pwm2=1;
						break;
		
		case 2:	led=0;
						pwm1=0;				//2档
						pwm2=0;
						break;
				
		case 3:	led=1;
						pwm1=1;				//停止
						pwm2=1;
						break;
	}
}


void OLED_ShowNumber(unsigned char x, y,int num,unsigned char str[],unsigned char len) 				//显示数字
{  
    sprintf(str, "%d", num); // 将数字转换为字符串
		str[len-1]='\0';
    Xianshi_8X16(x, y, str); // 显示数字  
}  


void OLED_Showfloat(unsigned char x, y,unsigned char str[],float temp) 												//显示字符串
{  
	sprintf(str, "%.1f", temp); // 将浮点数转换为字符串
	str[2]='.';
	if(str[3]=='.')																																								
	{
		str[3]=str[1];
	}
	str[4]='\0';
	Xianshi_8X16(x, y, str); // 显示字符串
	
}  







